/*
 * Local Corne underglow overlay for nice!nano v2.
 *
 * Keeping this in the config repo avoids relying on upstream ZMK internal
 * paths from inside the user keymap.
 */

&spi1 {
    compatible = "nordic,nrf-spi";
    /* Cannot be used together with i2c0. */
    status = "okay";
    mosi-pin = <6>;
    /* Unused pins, required for the SPI definition. */
    sck-pin = <5>;
    miso-pin = <7>;

    led_strip: ws2812@0 {
        compatible = "worldsemi,ws2812-spi";
        label = "SK6812mini";

        /* SPI */
        reg = <0>;
        spi-max-frequency = <4000000>;

        /* WS2812 */
        chain-length = <6>;
        spi-one-frame = <0x70>;
        spi-zero-frame = <0x40>;
    };
};

/ {
    chosen {
        zmk,underglow = &led_strip;
    };
};
